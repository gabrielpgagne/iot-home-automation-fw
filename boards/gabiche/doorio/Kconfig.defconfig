## boards/gabiche/doorio/board.yml
```yaml
board:
  name: doorio
  full_name: Doorio
  vendor: Gabiche
  socs:
    - name: nrf52833
```

## boards/gabiche/doorio/doorio_defconfig
```kconfig
CONFIG_ARM_MPU=y
# CONFIG_HW_STACK_PROTECTION=y

CONFIG_GPIO=y

CONFIG_SERIAL=y

# enable console
CONFIG_CONSOLE=y
CONFIG_UART_CONSOLE=y

# 32kHz clock source
CONFIG_CLOCK_CONTROL_NRF_K32SRC_RC=y
CONFIG_CLOCK_CONTROL_NRF_K32SRC_500PPM=y
```
